/**************************************************************************** 
*	File: LCM240320.c
*	Description: LCD display
*	Created Date: 2011-7-26
*	Last Modified: 2011-7-26
*	Author: linda
*	Notes: None
*****************************************************************************/
//#include <reg52.h>
#include <STC12C5A.h>
#include <absacc.h>
#include <intrins.h>
#include <math.h>
#include <string.h>

#define uint unsigned int
#define uchar unsigned char
sbit    LED=P5^3;
void WriteCommand(uchar Command);
void WriteData(uchar DData);

uchar code numb[ ]=		{0x00,0x00,0x00,0x00,0x00,0x00,0x07,0x0F,0x1C,0x38,0x38,0x38,0x70,0x70,0x70,0x70,
                         0x70,0x70,0x70,0x70,0x70,0x38,0x38,0x18,0x1C,0x0F,0x07,0x00,0x00,0x00,0x00,0x00,
						 0x00,0x00,0x00,0x00,0x00,0x00,0xE0,0xF0,0x38,0x1C,0x1C,0x1C,0x0E,0x0E,0x0E,0x0E,
						 0x0E,0x0E,0x0E,0x0E,0x0E,0x1C,0x1C,0x1C,0x38,0xF0,0xE0,0x00,0x00,0x00,0x00,0x00,/*"0",0*//* (16 X 32 , 黑体 )*/
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						 0x00,0x00,0x00,0x00,0x00,0x00,0x00,0x00,0x00,0x00,0x00,0x00,0x00,0x00,0x00,0x00};/*".",0*//* (16 X 32 , 黑体 )*/



unsigned  char bdata temp_flg,dis_flg;

sbit  dis_all=temp_flg^6;
sbit  dis_fresh=dis_flg^0;

extern  uchar  lcd_dat;

extern struct date
{
unsigned char hsec;
unsigned char sec;
}xtimer1,timer2,timer3,timer4,timer5,timer6,timer7,timer8;




void init_timer0();
void timer0();


void init_timer1();
void timer1();

void LCD_Init();
void LCD_Clear(uchar dat);

void LCD_Write32x16Char1(uchar addx, uchar addy, uchar code *DData, uchar m);

void counter_init();

void io_init()
{
    P4SW=0xff;	
} 


uint ql;


/* 主程序 */
main()
{ 

CLK_DIV=0X00;	  //外部石英晶体时钟，不分频.
ql=(PCON&0X10);   //上电初始化判定位
if(ql==0X10)      //如果为上电复位，显示初始化并清屏
{
PCON=0X20;        //(PCON&&0XEF);
LCD_Init();
dis_all=1;

}

counter_init();

io_init();											

IP|=0X80;
dis_fresh=0;
init_timer0();	    //定时器0初始化，按键扫描，计时，动作时间控制
init_timer1();	    //显示控制


while(1)
    {
	   	if(dis_fresh==1)
		{
		 
		 dis_fresh=0;
		 if(lcd_dat==1)
		 {
		 LCD_Write32x16Char1(240,11,numb,xtimer1.sec%10);
		 LCD_Write32x16Char1(2,12,numb,timer2.sec%10);
		 LCD_Write32x16Char1(48,18,numb,timer3.sec%10);
		 LCD_Write32x16Char1(66,18,numb,timer4.sec%10);
		 
		 LCD_Write32x16Char1(112,24,numb,timer5.sec%10);
		 LCD_Write32x16Char1(130,24,numb,timer6.sec%10);
		 LCD_Write32x16Char1(176,30,numb,timer7.sec%10);
		 LCD_Write32x16Char1(194,30,numb,timer8.sec%10);
		 
		 LCD_Write32x16Char1(236,11,numb,xtimer1.sec/10);
		 LCD_Write32x16Char1(254,11,numb,timer2.sec/10);
		 }

		 if(lcd_dat==2)
		 {

		 LCD_Write32x16Char1(44,18,numb,timer3.sec/10);
		 LCD_Write32x16Char1(62,18,numb,timer4.sec/10);

		 LCD_Write32x16Char1(126,24,numb,timer5.sec/10);
		 LCD_Write32x16Char1(108,24,numb,timer6.sec/10);

		 LCD_Write32x16Char1(172,30,numb,timer7.sec/10);
		 LCD_Write32x16Char1(190,30,numb,timer8.sec/10);

		 LCD_Write32x16Char1(234,11,numb,xtimer1.hsec%10);
		 LCD_Write32x16Char1(252,11,numb,timer2.hsec%10);

		 LCD_Write32x16Char1(42,18,numb,timer3.hsec%10);
		 LCD_Write32x16Char1(60,18,numb,timer4.hsec%10);

		 }

		 if(lcd_dat==3)
		 {

		 LCD_Write32x16Char1(106,24,numb,timer5.hsec%10);
		 LCD_Write32x16Char1(124,24,numb,timer6.hsec%10);


		 LCD_Write32x16Char1(170,30,numb,timer7.hsec%10);
		 LCD_Write32x16Char1(188,30,numb,timer8.hsec%10);


	     LCD_Write32x16Char1(232,11,numb,xtimer1.hsec/10);
		 LCD_Write32x16Char1(250,11,numb,timer2.hsec/10);

		 LCD_Write32x16Char1(40,18,numb,timer3.hsec/10);
		 LCD_Write32x16Char1(58,18,numb,timer4.hsec/10);

         LCD_Write32x16Char1(104,24,numb,timer5.hsec/10);
		 LCD_Write32x16Char1(122,24,numb,timer6.hsec/10);

		 }

		 if(lcd_dat==4)
		 {

		 LCD_Write32x16Char1(168,30,numb,timer7.hsec/10);
		 LCD_Write32x16Char1(186,30,numb,timer8.hsec/10);


		 LCD_Write32x16Char1(238,11,numb,10);
		 LCD_Write32x16Char1(0,12,numb,10);
		 LCD_Write32x16Char1(46,18,numb,10);       
		 LCD_Write32x16Char1(64,18,numb,10);
		 LCD_Write32x16Char1(110,24,numb,10);       
		 LCD_Write32x16Char1(128,24,numb,10);
		 LCD_Write32x16Char1(174,30,numb,10);		
  		 LCD_Write32x16Char1(192,30,numb,10);
        


        WriteCommand(0x46);
        WriteData(0x10);
        WriteData(0x26);

   }
   

   }
   
	   			    
    }
}

